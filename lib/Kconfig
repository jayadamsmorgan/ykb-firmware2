## lib/Kconfig
```kconfig
# SPDX-License-Identifier: Apache-2.0

menu "Libraries"

    rsource "connect/Kconfig"
    rsource "keyboard/Kconfig"

endmenu
```

## lib/connect/Kconfig
```kconfig
# SPDX-License-Identifier: Apache-2.0

menu "Connection"

rsource "usb_connect/Kconfig"
rsource "bt_connect/Kconfig"

endmenu
```

## lib/connect/bt_connect/Kconfig
```kconfig
config LIB_BT_CONNECT
    bool "Support for BLE HID connection"
    default y
    depends on YKB_BT_ENABLED
    select BT
    select BT_SMP
    select BT_BONDABLE
    select BT_PERIPHERAL
    select BT_DIS
    select BT_BAS
    select BT_BAS_BLS
    select SETTINGS
    select BT_SETTINGS
    select BT_HCI_ERR_TO_STR
    select BT_USER_CONN_PARAM_UPDATE
    help
        This option enables the 'BTConnect' library.

if LIB_BT_CONNECT

    config BT_INTER_KB_COMM
        bool "Inter-keyboard communication"
        default y
        help
          Enables communication between two keyboard halves
          to act as one keyboard if connected.

    if BT_INTER_KB_COMM

        config BT_INTER_KB_COMM_MASTER
            bool

        config BT_INTER_KB_COMM_SLAVE
            bool

        choice BT_CONNECT_MASTER
            bool "Inter-keyboard communication master"
            default BT_CONNECT_MASTER_LEFT
            help
              Keyboard half considered to be master in
              inter-keyboard communication

            config BT_CONNECT_MASTER_LEFT
                select BT_INTER_KB_COMM_MASTER if YKB_LEFT
                select BT_INTER_KB_COMM_SLAVE if YKB_RIGHT
                bool "Left"

            config BT_CONNECT_MASTER_RIGHT
                select BT_INTER_KB_COMM_MASTER if YKB_RIGHT
                select BT_INTER_KB_COMM_SLAVE if YKB_LEFT
                bool "Right"

        endchoice

    endif # BT_INTER_KB_COMM

endif # LIB_BT_CONNECT

module = BT_CONNECT
module-str = bt_connect
source "subsys/logging/Kconfig.template.log_config"
```

## lib/connect/bt_connect/Kconfig.defconfig
```kconfig
if LIB_BT_CONNECT

    config BT_MAX_PAIRED
        default 4

    config BT_MAX_CONN
        default 2

    config BT_MAX_PAIRED
        default 5

endif # LIB_BT_CONNECT
```

## lib/connect/usb_connect/Kconfig
```kconfig
config LIB_USB_CONNECT
    bool "Support for USB HID connection"
    default y
    depends on YKB_USB_ENABLED
    help
      This option enables the 'USBConnect' library.

module = USB_CONNECT
module-str = usb_connect
source "subsys/logging/Kconfig.template.log_config"
```

## lib/keyboard/Kconfig
```kconfig
# SPDX-License-Identifier: Apache-2.0

menu "Keyboard"

    rsource "kb_handle/Kconfig"
    rsource "kb_settings/Kconfig"

endmenu
```

## lib/keyboard/kb_handle/Kconfig
```kconfig
menu "Keyboard handling"

    choice KB_HANDLE_REPORT_PRIORITY
        bool "HID Report sending priority"
        default KB_HANDLE_REPORT_PRIO_USB
        depends on YKB_BT_ENABLED
        depends on YKB_USB_ENABLED

        config KB_HANDLE_REPORT_PRIO_USB
            bool "USB first"

        config KB_HANDLE_REPORT_PRIO_BT
            bool "BT first"

    endchoice

    config KB_HANDLE_IMPL_NORMAL
        bool
        default y if !BT_INTER_KB_COMM_SLAVE && !BT_INTER_KB_COMM_MASTER

    config KB_HANDLE_IMPL_SLAVE
        bool
        default y if BT_INTER_KB_COMM_SLAVE

    config KB_HANDLE_IMPL_MASTER
        bool
        default y if BT_INTER_KB_COMM_MASTER

    config KB_FN_KEYSTROKE_MAX_KEYS
        int "Maximum amount of keys allowed for FN-based keystrokes"
        default 3

    module = KB_HANDLE
    module-str = kb_handle
    source "subsys/logging/Kconfig.template.log_config"

endmenu
```

## lib/keyboard/kb_settings/Kconfig
```kconfig
menu "Keyboard settings"

    config KB_KEY_COUNT
        int "Amount of keyboard keys"
        help
          Specify the amount of keys available

    config KB_MAX_LAYERS_SUPPORTED
        int "Maximum amount of layers supported by the keyboard"
        range 1 10
        default 5

    config KB_SETTINGS_DEFAULT_POLLING_RATE
        int "Default polling rate (ms)"
        default 1

    config KB_SETTINGS_DEFAULT_MINIMUM
        int "Default value for key not pressed"
        range 0 1023

    config KB_SETTINGS_DEFAULT_MAXIMUM
        int "Default value for key pressed fully"
        range 0 1023

    config KB_SETTINGS_DEFAULT_THRESHOLD
        int "Default key press threshold (%age)"
        range 1 100
        default 65
        help
          Default threshold of when a key is considered pressed on a keyboard.
          Should be a value of 1-100  where 100 - key fully pressed down, 1 - just barely touched.
          This value is a part of keyboard settings and can be changed at runtime with YKBConfigurator.

    module = KB_SETTINGS
    module-str = kb_settings
    source "subsys/logging/Kconfig.template.log_config"

endmenu
```

## lib/led/Kconfig
```kconfig
# SPDX-License-Identifier: Apache-2.0

menu "LED"

    rsource "kb_backlight/Kconfig"

endmenu
```

## lib/led/kb_backlight/Kconfig
```kconfig
DT_CHOSEN_BACKLIGHT_FEATURE := ykb,backlight

menuconfig KB_BACKLIGHT
    bool "Backlight driver"
    depends on LED || LED_STRIP || LED_STRIP_CUSTOM
    depends on $(dt_chosen_enabled,$(DT_CHOSEN_BACKLIGHT_FEATURE))
    help
      This option enables backlight support for YKB keyboards.

if KB_BACKLIGHT

    choice KB_BACKLIGHT_DEVICE
        bool "Backlight device (LED or LED strip)"
    
        config KB_BACKLIGHT_DEVICE_LED
            bool "Backlight device RGB LED used"
            depends on LED
        
        config KB_BACKLIGHT_DEVICE_LED_STRIP
            bool "Backlight device ARGB LED strip used"
            depends on LED_STRIP || LED_STRIP_CUSTOM

    endchoice

    config KB_BACKLIGHT_FPS
        int "Target FPS for backlight modes to render"
        default 30
        range 1 60

    config KB_BACKLIGHT_MAX_BRIGHTNESS_COMBINED
        int "Value considered as maximum combined value of RGB (0 - 255*3)"
        range 0 765
        default 100
       
    module = KB_BACKLIGHT
    module-str = kb_backlight
    source "subsys/logging/Kconfig.template.log_config"

    if KB_BACKLIGHT_DEVICE_LED
        rsource "Kconfig.led"
    endif # BACKLIGHT_DEVICE_LED

    if KB_BACKLIGHT_DEVICE_LED_STRIP
        rsource "Kconfig.led_strip"
    endif # BACKLIGHT_DEVICE_LED_STRIP

endif # BACKLIGHT
```
