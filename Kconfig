## dts/bindings/mux/mux-gpio.yaml
```yaml
# SPDX-License-Identifier: Apache-2.0

title: GPIO-Select Multiplexer

description: >
  Generic channel multiplexer controlled by a set of select GPIOs (and optional
  enable GPIO). Channels are addressed by an integer index; the mapping from
  index to select lines is binary unless channel-map is provided.

compatible: "mux-gpio"

include: base.yaml

properties:
  sel-gpios:
    type: phandle-array
    required: true
    description: Select GPIOs, LSB first (idx 0 is bit0).

  enable-gpios:
    type: phandle-array
    required: false
    description: Optional enable/enable-bar pin.

  channels:
    type: int
    required: false
    description: >
      Number of valid channels. If omitted, defaults to 1 << <len(sel-gpios)>.

  settle-us:
    type: int
    required: false
    description: Delay (microseconds) to wait after switching before use.

  idle-channel:
    type: int
    required: false
    description: >
      Channel to select when going idle. If omitted, driver leaves last value
      (or disables via enable-gpios if provided).

  channel-map:
    type: array
    required: false
    description: >
      Optional LUT: physical channel order -> binary code (one u32 per channel).
      If present, its length defines channels. Values are the raw bit pattern
      to drive on sel-gpios (LSB=idx 0).

"#mux-cells": []
```
