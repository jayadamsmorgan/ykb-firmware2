## Kconfig
```kconfig
# SPDX-License-Identifier: Apache-2.0

if YKB_FIRMWARE

    rsource "drivers/Kconfig"
    rsource "lib/Kconfig"

    rsource "Kconfig.ykb"

endif # YKB_FIRMWARE
```

## Kconfig.ykb
```kconfig
menu "YKB Firmware"

    config YKB_SPLIT
        bool "Enable support for split keyboards"
        default n

    if YKB_SPLIT
        choice YKB_LEFT_RIGHT
            bool "Left/Right"
            help
              "Compile YKB firmware for left or right keyboard"

            config YKB_LEFT
                bool "Left"

            config YKB_RIGHT
                bool "Right"
        endchoice
    endif # YKB_SPLIT

    rsource "Kconfig.ykb.usb"
    rsource "Kconfig.ykb.bt"

endmenu
```

## Kconfig.ykb.bt
```kconfig
menuconfig YKB_BT_ENABLED
    bool "BT support"
    help
      This option enables the support for Bluetooth on YarmanKeyboards keyboard
```

## Kconfig.ykb.usb
```kconfig
menuconfig YKB_USB_ENABLED
    bool "USB support"
    help
      This option enables the support for USB on YarmanKeyboards keyboard

if YKB_USB_ENABLED
    config YKB_USBD_MANUFACTURER
        string "USB device manufacturer string"
        default "YarmanKeyboards"
        help
            USB device manufacturer string.

    config YKB_USBD_VID
        hex "USB deviced Vendor ID"
        default 0x6969
        help
            USB device Vendor ID.

    config YKB_USBD_PRODUCT
        string "USB device product string"
        help
            USB device product string.

    config YKB_USBD_PID
        hex "USB device Product ID (Left)"
        help
            USB device Product ID for left keyboard. The right keyboard Product ID would be `LEFT_ID + 1`.

    config YKB_USBD_SELF_POWERED
        bool "USB device Self-powered attribute"
        default y
        help
            Set the Self-powered attribute in the configuration.

    config YKB_USBD_REMOTE_WAKEUP
        bool "USB device Remote Wakeup attribute"
        help
            Set the Remote Wakeup attribute in the configuration.

    config YKB_USBD_MAX_POWER
        int "USB device bMaxPower value"
        range 0 250
        help
            bMaxPower value in the configuration in 2 mA units.

    config YKB_USBD_20_EXTENSION_DESC
        bool "Use default USB 2.0 Extension Descriptor"
        depends on USBD_BOS_SUPPORT
        help
            Set bcdUSB value to 0201 and use default USB 2.0 Extension Descriptor.

endif # YKB_USB
```

## boards/ykb/choco_v1/Kconfig.defconfig
```kconfig
if BOARD_CHOCO_V1

    config BT_STM32_IPM
        default y
        depends on BT

    if BT_INTER_KB_COMM_MASTER

        config BT_PERIPHERAL
            default y

        config BT_DIS
            default y

        config BT_BAS
            default y

        config BT_BAS_BLS
            default y

        config BT_GAP_PERIPHERAL_PREF_PARAMS
            default y
        
        config BT_PERIPHERAL_PREF_MIN_INT
            default 6
        
        config BT_PERIPHERAL_PREF_MAX_INT
            default 24
        
        config BT_PERIPHERAL_PREF_LATENCY
            default 1
        
        config BT_PERIPHERAL_PREF_TIMEOUT
            default 600

        config  BT_GAP_AUTO_UPDATE_CONN_PARAMS
            default y
    endif # BT_INTER_KB_COMM_MASTER
    
    if BT_INTER_KB_COMM_SLAVE

        config BT_CENTRAL
            default y

        config BT_GATT_CLIENT
            default y
        
        config BT_SCAN_WITH_IDENTITY
            default y
   
    endif # BT_INTER_KB_COMM_SLAVE
    
    if YKB_USB_ENABLED

        config USB_DEVICE_STACK_NEXT
            default y

        config CDC_ACM_SERIAL_INITIALIZE_AT_BOOT
            default y

        config USBD_HID_SUPPORT
            default y

        config YKB_USBD_REMOTE_WAKEUP
            default y

        config YKB_USBD_MAX_POWER
            default 125 # 125*2ma=250ma

    endif # YKB_USB_ENABLED

    if YKB_BT_ENABLED

        config BT_DEVICE_APPEARANCE
            default 961

        config BT_MAX_PAIRED
            default 10

        config BT_MAX_CONN
            default 4
    endif # YKB_BT_ENABLED
    if BT_INTER_KB_COMM

        config BT_L2CAP_DYNAMIC_CHANNEL
            default y

        config BT_L2CAP_ECRED
            default y

        config BT_BUF_ACL_RX_SIZE
            default 1024

        config BT_BUF_ACL_TX_SIZE
            default 1024

        config BT_BUF_ACL_TX_COUNT
            default 20

        config BT_BUF_EVT_RX_COUNT
            default 30
    
    endif # YKB_INTER_KB_COM
    if YKB_RIGHT

        config YKB_USBD_PRODUCT
            default "YKB Choco V1 (Right)"
            depends on LIB_USB_CONNECT

        config YKB_USBD_PID
            default 0x0003
            depends on LIB_USB_CONNECT

        config BT_DEVICE_NAME
            default "YKB Choco V1 (Right)"
            depends on LIB_BT_CONNECT

    endif # YKB_RIGHT

    if YKB_LEFT

        config YKB_USBD_PRODUCT
            default "YKB Choco V1 (Left)"
            depends on LIB_USB_CONNECT

        config YKB_USBD_PID
            default 0x0004
            depends on LIB_USB_CONNECT

        config BT_DEVICE_NAME
            default "YKB Choco V1 (Left)"
            depends on LIB_BT_CONNECT

    endif # YKB_LEFT

endif # BOARD_CHOCO_V1
```

## boards/ykb/choco_v1/choco_v1_defconfig
```kconfig
# enable GPIO
CONFIG_GPIO=y

# Enable MPU
CONFIG_ARM_MPU=y

# Enable HW stack protection
CONFIG_HW_STACK_PROTECTION=y

# USB
CONFIG_USB_DEVICE_STACK_NEXT=y
CONFIG_CDC_ACM_SERIAL_INITIALIZE_AT_BOOT=n
CONFIG_USBD_HID_SUPPORT=y
# MAX_POWER: 125*2ma=250ma MAX
CONFIG_YKB_USBD_MAX_POWER=125
CONFIG_YKB_USBD_REMOTE_WAKEUP=y

# BT
CONFIG_SYSTEM_WORKQUEUE_STACK_SIZE=2048
CONFIG_BT=y
CONFIG_BT_SMP=y
CONFIG_BT_BONDABLE=y
CONFIG_BT_PRIVACY=y
CONFIG_BT_PERIPHERAL=y
CONFIG_BT_DIS=y
CONFIG_BT_BAS=y
CONFIG_BT_BAS_BLS=y
CONFIG_BT_DEVICE_APPEARANCE=961
CONFIG_BT_SETTINGS=y
CONFIG_FLASH=y
CONFIG_FLASH_MAP=y
CONFIG_NVS=y
CONFIG_SETTINGS=y
CONFIG_BT_HCI_ERR_TO_STR=y
CONFIG_BT_GAP_AUTO_UPDATE_CONN_PARAMS=y
CONFIG_BT_MAX_PAIRED=10
CONFIG_BT_MAX_CONN=2

# KB
CONFIG_KSCAN_ENABLES=y
CONFIG_KB_KEY_COUNT=22
CONFIG_KB_SETTINGS_DEFAULT_MINIMUM=500
CONFIG_KB_SETTINGS_DEFAULT_MAXIMUM=1023
CONFIG_KB_SETTINGS_DEFAULT_THRESHOLD=75

# EEPROM
CONFIG_EEPROM=y
CONFIG_EEPROM_EMULATOR=y

# Backlight
# CONFIG_LED_STRIP_CUSTOM=y
# CONFIG_WS2812_STRIP_PWM_DMA_STM32WB=y
```

## boards/ykb/dactyl_v1/Kconfig.defconfig
```kconfig
if BOARD_DACTYL_V1

    config BT_STM32_IPM
        default y
        depends on BT

    if BT_INTER_KB_COMM_MASTER

        config BT_CENTRAL
            default y

        config BT_GATT_CLIENT
            default y

        config BT_FILTER_ACCEPT_LIST
            default y

        config BT_SCAN_WITH_IDENTITY
            default y

    endif # BT_INTER_KB_COMM_MASTER

    if BT_INTER_KB_COMM_SLAVE

        config BT_GAP_PERIPHERAL_PREF_PARAMS
            default y
        
        config BT_PERIPHERAL_PREF_MIN_INT
            default 6
        
        config BT_PERIPHERAL_PREF_MAX_INT
            default 6
        
        config BT_PERIPHERAL_PREF_LATENCY
            default 0 
        
        config BT_PERIPHERAL_PREF_TIMEOUT
            default 400

    endif # BT_INTER_KB_COMM_SLAVE

    if YKB_USB_ENABLED

        config USB_DEVICE_STACK_NEXT
            default y

        config CDC_ACM_SERIAL_INITIALIZE_AT_BOOT
            default y

        config USBD_HID_SUPPORT
            default y

        config YKB_USBD_REMOTE_WAKEUP
            default y

        config YKB_USBD_MAX_POWER
            default 125 # 125*2ma=250ma

    endif # YKB_USB_ENABLED

    if YKB_BT_ENABLED

        config BT_DEVICE_APPEARANCE
            default 961

        config BT_MAX_PAIRED
            default 10

        config BT_MAX_CONN
            default 2

    endif # YKB_BT_ENABLED


    if YKB_RIGHT

        config YKB_USBD_PRODUCT
            default "YKB Dactyl V1 (Right)"
            depends on LIB_USB_CONNECT

        config YKB_USBD_PID
            default 0x0001
            depends on LIB_USB_CONNECT

        config BT_DEVICE_NAME
            default "YKB Dactyl V1 (Right)"
            depends on LIB_BT_CONNECT

    endif # YKB_RIGHT

    if YKB_LEFT

        config YKB_USBD_PRODUCT
            default "YKB Dactyl V1 (Left)"
            depends on LIB_USB_CONNECT

        config YKB_USBD_PID
            default 0x0002
            depends on LIB_USB_CONNECT

        config BT_DEVICE_NAME
            default "YKB Dactyl V1 (Left)"
            depends on LIB_BT_CONNECT

    endif # YKB_LEFT

endif # BOARD_DACTYL_V1
```

## boards/ykb/dactyl_v1/dactyl_v1_defconfig
```kconfig
CONFIG_ARM_MPU=y
CONFIG_HW_STACK_PROTECTION=y
CONFIG_SYSTEM_WORKQUEUE_STACK_SIZE=2048
```

## drivers/Kconfig
```kconfig
# SPDX-License-Identifier: Apache-2.0

menu "Drivers"
    rsource "kscan/Kconfig"
    rsource "mux/Kconfig"
    rsource "led_strip_custom/Kconfig"
endmenu
```

## drivers/kscan/Kconfig
```kconfig
menuconfig KSCAN
	bool "KScan drivers"
    default y
	help
	  This option enables the KScan custom driver class.

if KSCAN

choice KSCAN_BACKEND
    bool "KScan driver backend"
    default KSCAN_MUXES

    config KSCAN_MUXES
        bool "KScan MUXes driver backend"
        depends on DT_HAS_KSCAN_MUXES_ENABLED
        select ADC
        help
          Enable this option to use the logic of multiplexors to poll keyboard keys.

endchoice

module = KSCAN
module-str = kscan
source "subsys/logging/Kconfig.template.log_config"

rsource "Kconfig.muxes"

endif # KSCAN
```

## drivers/kscan/Kconfig.enables
```kconfig
if KSCAN_ENABLES

    config KSCAN_ENABLES_MAX_EN_CNT
        int "Maximum amount of 'enable' pins supported by driver"
        default 30

    config KSCAN_ENABLES_MAX_ADC_CH_CNT
        int "Maximum amount of ADC channels supported by driver"
        default 3

endif # KSCAN_ENABLES
```

## drivers/kscan/Kconfig.muxes
```kconfig
if KSCAN_MUXES

config KSCAN_MUXES_MAX_MUX_CNT
    int "Maximum amount of multiplexors driver supports"
    default 3
    help
      Maximum amount of multiplexors driver supports.

endif # KSCAN_MUXES
```

## drivers/led_strip/Kconfig
```kconfig
if LED_STRIP

config WS2812_STRIP_PWM_DMA_STM32
    bool "WS2812 LED strip PWM + DMA driver for STM32"
    depends on SOC_FAMILY_STM32
    default y
    select USE_STM32_HAL_TIM
    select USE_STM32_HAL_TIM_EX
    select USE_STM32_HAL_DMA
    select SHARED_INTERRUPTS
    help
      Enable driver for WS2812 (and compatibles) LED strip using PWM and DMA on STM32 devices.

endif # LED_STRIP
```

## drivers/led_strip/Kconfig.ws2812
```kconfig
config WS2812_STRIP_PWM
    bool "WS2812 LED strip PWM driver"
    default y
    depends on DT_HAS_WORLDSEMI_WS2812_PWM_ENABLED
    select PWM
    help
      Enable driver for WS2812 (and compatibles) LED strip using PWM.
```

## drivers/led_strip_custom/Kconfig
```kconfig
config LED_STRIP_CUSTOM
    bool "Enable custom drivers for addressable LED strips"

if LED_STRIP_CUSTOM

    rsource "Kconfig.pwm_dma_stm32wb"

    if !LED_STRIP
        # Everything below is needed to remove warning and errors
        # when LED_STRIP=n since we are extending LED_STRIP
        module = LED_STRIP
        module-str = led_strip
        source "subsys/logging/Kconfig.template.log_config"

        config LED_STRIP_INIT_PRIORITY
            int "LED strip initialization priority"
            default 90
            help
              System initialization priority for LED strip drivers.
    endif # LED_STRIP

endif # LED_STRIP_CUSTOM
```

## drivers/led_strip_custom/Kconfig.pwm_dma_stm32wb
```kconfig
config WS2812_STRIP_PWM_DMA_STM32WB
    bool "WS2812 LED strip PWM + DMA driver for STM32WB"
    depends on SOC_SERIES_STM32WBX
    depends on DT_HAS_WS2812_PWM_DMA_STM32WB_ENABLED
    default y
    select DMA
    select PWM
    select USE_STM32_HAL_TIM
    select USE_STM32_HAL_TIM_EX
    select USE_STM32_HAL_DMA
    select SHARED_INTERRUPTS
    help
      Enable driver for WS2812 (and compatibles) LED strip using PWM and DMA on STM32WB series devices.
```

## dts/bindings/kscan/kscan-enables.yaml
```yaml
# SPDX-License-Identifier: Apache-2.0

description: |
  A generic binding for a GPIO-controlled blinking LED. Note that this binding
  has no vendor prefix, as it does not target a specific device or vendor.

  Example definition in devicetree:

    blink-gpio-led {
        compatible = "blink-gpio-led";
        led-gpios = <&gpio0 0 GPIO_ACTIVE_HIGH>;
        blink-period-ms = <1000>;
    };

compatible: "kscan-enables"

include: base.yaml

properties:
  gpios:
    type: phandle-array
    required: true
  io-channels:
    type: phandle-array
    required: true
  map:
    type: array
    required: true
```

## dts/bindings/kscan/kscan-muxes.yaml
```yaml
# SPDX-License-Identifier: Apache-2.0

description: |
  A generic binding for a GPIO-controlled blinking LED. Note that this binding
  has no vendor prefix, as it does not target a specific device or vendor.

  Example definition in devicetree:

    blink-gpio-led {
        compatible = "blink-gpio-led";
        led-gpios = <&gpio0 0 GPIO_ACTIVE_HIGH>;
        blink-period-ms = <1000>;
    };

compatible: "kscan-muxes"

include: base.yaml

properties:
  muxes:
    type: phandle-array
    specifier-space: mux
    required: true
  mux-names:
    type: string-array
    required: false
    description: Optional names for the mux channels (debug only)
  io-channels:
    type: phandle-array
    required: true
    description: >
      List of ADC channels. Should be the same amount and in same order
      as corresponding multiplexors.
  io-channel-names:
    type: string-array
    required: false
    description: Optional names for the io-channels (debug only)
```

## dts/bindings/led_strip/worldsemi,ws2812-pwm.yaml
```yaml
# SPDX-License-Identifier: Apache-2.0

description: |
  Worldesemi WS2812 LED strip, PWM binding

compatible: "worldsemi,ws2812-pwm"

include: [base.yaml, ws2812.yaml]

properties:
  pwms:
    type: phandle-array
    required: true
    description: |
      PWM phandle and specifier for the pin connected to the
      led-strip. Exactly one PWM should be given.
```

## dts/bindings/led_strip/ws2812-pwm-dma-stm32wb.yaml
```yaml
# SPDX-License-Identifier: Apache-2.0
description: WS2812 via STM32 HAL (PWM + DMA), STM32WB only

compatible: "ws2812-pwm-dma-stm32wb"

include: [base.yaml, ws2812.yaml]

properties:
  st,tim-base:
    type: int
    required: true
    description: Absolute base address of TIM instance (e.g., TIM2 base).

  st,tim-channel:
    type: int
    required: true
    description: |
      HAL TIM channel number (1..4). Will be mapped to TIM_CHANNEL_x.

  st,dma-chan-inst:
    type: int
    required: true
    description: |
      Absolute address of DMA channel instance (e.g., (uint32_t)DMA1_Channel5).

  st,dma-chan-irqn:
    type: int
    required: true

  st,dma-req:
    type: int
    required: true
  
  st,tim-dma-id:
    type: int
    required: true

  bit-rate:
    type: int
    required: true
```
